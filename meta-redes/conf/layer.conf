## meta-redes/conf/layer.conf
```bitbake
# We have a conf and classes directory, add to BBPATH
BBPATH .= ":${LAYERDIR}"

# We have recipes-* directories, add to BBFILES
BBFILES += "${LAYERDIR}/recipes-*/*/*.bb \
            ${LAYERDIR}/recipes-*/*/*.bbappend"

BBFILE_COLLECTIONS += "meta-redes"
BBFILE_PATTERN_meta-redes = "^${LAYERDIR}/"
BBFILE_PRIORITY_meta-redes = "6"

LAYERDEPENDS_meta-redes = "core"
LAYERSERIES_COMPAT_meta-redes = "dunfell"
```
